## main/KConfig
```kconfig
menu "ESPresso Configuration"

  menu "Temperature Sensor"
    choice
      prompt "Sensor"
      default BOILER_TEMP_SENSOR_MAX31865

      help
        Temperature sensor used for boiler temperature

      config BOILER_TEMP_SENSOR_MAX31865 
        bool "MAX31865"


			config MAX31865_PIN_MISO
						int "MAX31865 MISO Pin"
						depends on BOILER_TEMP_SENSOR_MAX31865 
						range 0 39
						default 12

			config MAX31865_PIN_MOSI
						int "MAX31865 MOSI Pin"
						depends on BOILER_TEMP_SENSOR_MAX31865
						range 0 39
						default 14

			config MAX31865_PIN_SCLK
						int "MAX31865 SCLK Pin"
						depends on BOILER_TEMP_SENSOR_MAX31865
						range 0 39
						default 13

			config MAX31865_PIN_CS
						int "MAX31865 nCS Pin"
						depends on BOILER_TEMP_SENSOR_MAX31865
						range 0 39
						default 27

			config MAX31865_PIN_DRDY
						int "MAX31865 nDRDY Pin"
						depends on BOILER_TEMP_SENSOR_MAX31865
						range 0 39
						default 26

    endchoice
  endmenu


endmenu
```
